## conf/layer.conf
```bitbake
# We have a conf and classes directory, append to BBPATH
BBPATH .= ":${LAYERDIR}"

# We have recipes-* directories, add to BBFILES
BBFILES += "${LAYERDIR}/recipes-*/*/*.bb ${LAYERDIR}/recipes-*/*/*.bbappend"

BBFILE_COLLECTIONS += "verdin-linium-systems"
BBFILE_PATTERN_verdin-linium-systems = "^${LAYERDIR}/"
BBFILE_PRIORITY_verdin-linium-systems = "25"

# Let us add layer-specific bbappends which are only applied when that
# layer is included in our configuration
BBFILES += "${@' '.join('${LAYERDIR}/%s/recipes*/*/*.bbappend' % layer \
               for layer in BBFILE_COLLECTIONS.split())}"
# Add layer-specific bb files too
BBFILES += "${@' '.join('${LAYERDIR}/%s/recipes*/*/*.bb' % layer \
               for layer in BBFILE_COLLECTIONS.split())}"

LAYERDEPENDS_verdin-linium-systems = " \
    core \
    yocto \
    openembedded-layer gnome-layer multimedia-layer networking-layer \
"
LAYERSERIES_COMPAT_verdin-linium-systems = "hardknott honister kirkstone"
```
